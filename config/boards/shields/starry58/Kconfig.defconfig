## config/boards/shields/starry58/Kconfig.defconfig
```kconfig
if SHIELD_STARRY58_LEFT

    config ZMK_KEYBOARD_NAME
        default "Starry58 (Left)"

    config ZMK_SPLIT_BLE_ROLE_CENTRAL
        default y

endif

if SHIELD_STARRY58_RIGHT

    config ZMK_KEYBOARD_NAME
        default "Starry58 (Right)"

endif

if SHIELD_STARRY58_LEFT || SHIELD_STARRY58_RIGHT

    config ZMK_SPLIT
        default y

endif
```

## config/boards/shields/starry58/Kconfig.shield
```kconfig
config SHIELD_STARRY58_LEFT
    def_bool $(shields_list_contains,starry58_left)

config SHIELD_STARRY58_RIGHT
    def_bool $(shields_list_contains,starry58_right)
```
